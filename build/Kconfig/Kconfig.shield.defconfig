## build/Kconfig/Kconfig.shield.defconfig
```kconfig
osource "c:/Users/Work/Documents/Clients/touchtronics/cellfund_less2_exer2_solution/boards/shields/*/Kconfig.defconfig"
osource "C:/ncs/v2.2.0/nrf/boards/shields/*/Kconfig.defconfig"
```
