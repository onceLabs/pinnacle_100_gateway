## CMakeLists.txt
```
#
# Copyright (c) 2020 Nordic Semiconductor
#
# SPDX-License-Identifier: LicenseRef-Nordic-5-Clause
#

cmake_minimum_required(VERSION 3.20.0)

find_package(Zephyr REQUIRED HINTS $ENV{ZEPHYR_BASE})
project(cellular_fundamentals)

# NORDIC SDK APP START
target_sources(app PRIVATE 
    src/main.c
    src/p100_socket.c
    src/ble.c
)
# NORDIC SDK APP END
```

## prj.conf
```kconfig
#
# Copyright (c) 2020 Nordic Semiconductor ASA
#
# SPDX-License-Identifier: LicenseRef-Nordic-5-Clause
#

CONFIG_NEWLIB_LIBC=y
CONFIG_NEWLIB_LIBC_FLOAT_PRINTF=y

# Logging
CONFIG_LOG=y

# Button and LED support
CONFIG_DK_LIBRARY=y

# Network
CONFIG_NETWORKING=y
CONFIG_NET_NATIVE=y
CONFIG_NET_SOCKETS=y
CONFIG_NET_SOCKETS_OFFLOAD=n
CONFIG_NET_SOCKETS_POSIX_NAMES=y
CONFIG_DNS_RESOLVER=y
CONFIG_NET_UDP=y
CONFIG_NET_IPV4=y
CONFIG_NET_IPV6=n

# BLE
CONFIG_BT=y
CONFIG_BT_DEBUG_LOG=y
CONFIG_BT_CENTRAL=y
CONFIG_BT_SMP=y
CONFIG_BT_GATT_CLIENT=y

# Memory
CONFIG_HEAP_MEM_POOL_SIZE=8192
CONFIG_MAIN_STACK_SIZE=8192

# Modem library
CONFIG_MODEM=y
CONFIG_MODEM_LOG_LEVEL_OFF=y
CONFIG_MODEM_HL7800=y
CONFIG_MODEM_HL7800_RAT_M1=n
CONFIG_MODEM_HL7800_FW_UPDATE=y
CONFIG_MODEM_HL7800_RECV_BUF_CNT=64
CONFIG_NET_PKT_RX_COUNT=8
CONFIG_NET_BUF_RX_COUNT=48
CONFIG_MODEM_HL7800_CONFIGURE_BANDS=y

# AT commands interface
CONFIG_UART_INTERRUPT_DRIVEN=y

# Logging
CONFIG_DEBUG=y
CONFIG_PRINTK=y
CONFIG_LOG_PRINTK=y
CONFIG_USE_SEGGER_RTT=y
```

## src/main.c
```c
/*
 * Copyright (c) 2020 Nordic Semiconductor ASA
 *
 * SPDX-License-Identifier: LicenseRef-Nordic-5-Clause
 */

#include <stdio.h>
#include <zephyr/kernel.h>
#include <zephyr/logging/log.h>
#include <dk_buttons_and_leds.h>

#include <zephyr/drivers/modem/hl7800.h>

#include "p100_socket.h"
#include "ble.h"

static K_SEM_DEFINE(lte_connected, 0, 1);

LOG_MODULE_REGISTER(Pinnacle_100_Gateway, LOG_LEVEL_INF);

static struct mdm_hl7800_apn *lte_apn_config;
static struct mdm_hl7800_callback_agent hl7800_evt_agent;

static void modem_event_callback(enum mdm_hl7800_event event, void *event_data)
{
	uint8_t code = ((struct mdm_hl7800_compound_event *)event_data)->code;
	char *s = (char *)event_data;

	switch (event)
	{
	case HL7800_EVENT_NETWORK_STATE_CHANGE:
		switch (code)
		{
		case HL7800_HOME_NETWORK:
		case HL7800_ROAMING:
			dk_set_led_on(DK_LED4);

			dk_set_led_off(DK_LED1);
			dk_set_led_off(DK_LED2);
			dk_set_led_off(DK_LED3);

			k_sem_give(&lte_connected);
			break;

		case HL7800_NOT_REGISTERED:
		case HL7800_REGISTRATION_DENIED:
		case HL7800_UNABLE_TO_CONFIGURE:
		case HL7800_OUT_OF_COVERAGE:
			dk_set_led_on(DK_LED3);
			break;

		case HL7800_SEARCHING:
			dk_set_led_on(DK_LED1);
			break;

		case HL7800_EMERGENCY:
		default:

			break;
		}
		break;

	case HL7800_EVENT_APN_UPDATE:
		/* event data points to static data stored in modem driver.
		 * Store the pointer so we can access the APN elsewhere in our app.
		 */
		lte_apn_config = (struct mdm_hl7800_apn *)event_data;
		break;

	case HL7800_EVENT_RSSI:
		break;

	case HL7800_EVENT_SINR:
		break;

	case HL7800_EVENT_STARTUP_STATE_CHANGE:
		switch (code)
		{
		case HL7800_STARTUP_STATE_READY:
		case HL7800_STARTUP_STATE_WAITING_FOR_ACCESS_CODE:
			break;
		case HL7800_STARTUP_STATE_SIM_NOT_PRESENT:
		case HL7800_STARTUP_STATE_SIMLOCK:
		case HL7800_STARTUP_STATE_UNRECOVERABLE_ERROR:
		case HL7800_STARTUP_STATE_UNKNOWN:
		case HL7800_STARTUP_STATE_INACTIVE_SIM:
		default:
			break;
		}
		break;

	case HL7800_EVENT_SLEEP_STATE_CHANGE:
		break;

	case HL7800_EVENT_RAT:
		break;

	case HL7800_EVENT_BANDS:
		break;

	case HL7800_EVENT_ACTIVE_BANDS:
		break;

	default:
		LOG_ERR("Unknown modem event");
		break;
	}
}

static void modem_configure(void)
{
	hl7800_evt_agent.event_callback = modem_event_callback;
	mdm_hl7800_register_event_callback(&hl7800_evt_agent);
}

void main(void)
{
	int ret = 0;

	if (dk_leds_init() != 0)
	{
		LOG_ERR("Failed to initialize the LEDs Library");
	}

	dk_set_led_on(DK_LED1);
	modem_configure();

	LOG_INF("Connecting to LTE network");

	k_sem_take(&lte_connected, K_FOREVER);

	LOG_INF("Connected to LTE network");
	p100_socket_init();
	ble_init();
}
```

## src/ble.c
```c
#include <zephyr/kernel.h>

#include <zephyr/types.h>
#include <stddef.h>
#include <errno.h>
#include <zephyr/kernel.h>
#include <zephyr/sys/printk.h>

#include <zephyr/bluetooth/bluetooth.h>
#include <zephyr/bluetooth/hci.h>
#include <zephyr/bluetooth/conn.h>
#include <zephyr/bluetooth/uuid.h>
#include <zephyr/bluetooth/gatt.h>
#include <zephyr/sys/byteorder.h>

#include "p100_socket.h"

#include "ble.h"

static void start_scan(void);

static struct bt_conn *default_conn;

static struct bt_uuid_16 uuid = BT_UUID_INIT_16(0);
static struct bt_gatt_discover_params discover_params;
static struct bt_gatt_subscribe_params subscribe_params;

static uint8_t notify_func(struct bt_conn *conn,
                           struct bt_gatt_subscribe_params *params,
                           const void *data, uint16_t length)
{
    int ret;

    if (!data)
    {
        printk("[UNSUBSCRIBED]\n");
        params->value_handle = 0U;
        return BT_GATT_ITER_STOP;
    }

    printk("[NOTIFICATION] data %p length %u\n", data, length);

    ret = p100_socket_send(data, length);

    if (ret < 0)
    {
        printk("Failed to send data to socket server\n");
    }
    else
    {
        printk("Successfully sent data to socket server, 0x%02x%02x\n", ((uint8_t *)data)[0], ((uint8_t *)data)[1]);
    }

    return BT_GATT_ITER_CONTINUE;
}

static uint8_t discover_func(struct bt_conn *conn,
                             const struct bt_gatt_attr *attr,
                             struct bt_gatt_discover_params *params)
{
    int err;

    if (!attr)
    {
        printk("Discover complete\n");
        (void)memset(params, 0, sizeof(*params));
        return BT_GATT_ITER_STOP;
    }

    printk("[ATTRIBUTE] handle %u\n", attr->handle);

    if (!bt_uuid_cmp(discover_params.uuid, BT_UUID_HRS))
    {
        memcpy(&uuid, BT_UUID_HRS_MEASUREMENT, sizeof(uuid));
        discover_params.uuid = &uuid.uuid;
        discover_params.start_handle = attr->handle + 1;
        discover_params.type = BT_GATT_DISCOVER_CHARACTERISTIC;

        err = bt_gatt_discover(conn, &discover_params);
        if (err)
        {
            printk("Discover failed (err %d)\n", err);
        }
    }
    else if (!bt_uuid_cmp(discover_params.uuid,
                          BT_UUID_HRS_MEASUREMENT))
    {
        memcpy(&uuid, BT_UUID_GATT_CCC, sizeof(uuid));
        discover_params.uuid = &uuid.uuid;
        discover_params.start_handle = attr->handle + 2;
        discover_params.type = BT_GATT_DISCOVER_DESCRIPTOR;
        subscribe_params.value_handle = bt_gatt_attr_value_handle(attr);

        err = bt_gatt_discover(conn, &discover_params);
        if (err)
        {
            printk("Discover failed (err %d)\n", err);
        }
    }
    else
    {
        subscribe_params.notify = notify_func;
        subscribe_params.value = BT_GATT_CCC_NOTIFY;
        subscribe_params.ccc_handle = attr->handle;

        err = bt_gatt_subscribe(conn, &subscribe_params);
        if (err && err != -EALREADY)
        {
            printk("Subscribe failed (err %d)\n", err);
        }
        else
        {
            printk("[SUBSCRIBED]\n");
        }

        return BT_GATT_ITER_STOP;
    }

    return BT_GATT_ITER_STOP;
}

static bool eir_found(struct bt_data *data, void *user_data)
{
    bt_addr_le_t *addr = user_data;
    char dev[BT_ADDR_LE_STR_LEN];
    int i;

    // printk("[AD]: %u data_len %u\n", data->type, data->data_len);

    switch (data->type)
    {
    case BT_DATA_UUID16_SOME:
    case BT_DATA_UUID16_ALL:
        if (data->data_len % sizeof(uint16_t) != 0U)
        {
            printk("AD malformed\n");
            return true;
        }

        for (i = 0; i < data->data_len; i += sizeof(uint16_t))
        {
            struct bt_le_conn_param *param;
            struct bt_uuid *uuid;
            uint16_t u16;
            int err;

            memcpy(&u16, &data->data[i], sizeof(u16));
            uuid = BT_UUID_DECLARE_16(sys_le16_to_cpu(u16));
            if (bt_uuid_cmp(uuid, BT_UUID_HRS) != 0)
            {
                continue;
            }

            bt_addr_le_to_str(addr, dev, sizeof(dev));
            printk("[DEVICE MATCH]: %s, AD evt type %u, AD data len %u\n",
                   dev, data->type, data->data_len);

            printk("[AD]: %u data_len %u\n", data->type, data->data_len);

            err = bt_le_scan_stop();
            if (err)
            {
                printk("Stop LE scan failed (err %d)\n", err);
                continue;
            }

            param = BT_LE_CONN_PARAM_DEFAULT;
            err = bt_conn_le_create(addr, BT_CONN_LE_CREATE_CONN,
                                    param, &default_conn);
            if (err)
            {
                printk("Create conn failed (err %d)\n", err);
                start_scan();
            }

            return false;
        }
    }

    return true;
}

static void device_found(const bt_addr_le_t *addr, int8_t rssi, uint8_t type,
                         struct net_buf_simple *ad)
{
    char dev[BT_ADDR_LE_STR_LEN];
    bt_addr_le_to_str(addr, dev, sizeof(dev));

    // printk("[DEVICE]: %s, AD evt type %u, AD data len %u, RSSI %i\n",
    //        dev, type, ad->len, rssi);

    /* We're only interested in connectable events */
    if (type == BT_GAP_ADV_TYPE_ADV_IND ||
        type == BT_GAP_ADV_TYPE_ADV_DIRECT_IND)
    {
        bt_data_parse(ad, eir_found, (void *)addr);
    }
}

static void start_scan(void)
{
    int err;

    /* Use active scanning and disable duplicate filtering to handle any
     * devices that might update their advertising data at runtime. */
    struct bt_le_scan_param scan_param = {
        .type = BT_LE_SCAN_TYPE_ACTIVE,
        .options = BT_LE_SCAN_OPT_NONE,
        .interval = BT_GAP_SCAN_FAST_INTERVAL,
        .window = BT_GAP_SCAN_FAST_WINDOW,
    };

    err = bt_le_scan_start(&scan_param, device_found);
    if (err)
    {
        printk("Scanning failed to start (err %d)\n", err);
        return;
    }

    printk("Scanning successfully started\n");
}

static void connected(struct bt_conn *conn, uint8_t conn_err)
{
    char addr[BT_ADDR_LE_STR_LEN];
    int err;

    bt_addr_le_to_str(bt_conn_get_dst(conn), addr, sizeof(addr));

    if (conn_err)
    {
        printk("Failed to connect to %s (%u)\n", addr, conn_err);

        bt_conn_unref(default_conn);
        default_conn = NULL;

        start_scan();
        return;
    }

    printk("Connected: %s\n", addr);

    if (conn == default_conn)
    {
        memcpy(&uuid, BT_UUID_HRS, sizeof(uuid));
        discover_params.uuid = &uuid.uuid;
        discover_params.func = discover_func;
        discover_params.start_handle = BT_ATT_FIRST_ATTRIBUTE_HANDLE;
        discover_params.end_handle = BT_ATT_LAST_ATTRIBUTE_HANDLE;
        discover_params.type = BT_GATT_DISCOVER_PRIMARY;

        err = bt_gatt_discover(default_conn, &discover_params);
        if (err)
        {
            printk("Discover failed(err %d)\n", err);
            return;
        }
    }
}

static void disconnected(struct bt_conn *conn, uint8_t reason)
{
    char addr[BT_ADDR_LE_STR_LEN];

    bt_addr_le_to_str(bt_conn_get_dst(conn), addr, sizeof(addr));

    printk("Disconnected: %s (reason 0x%02x)\n", addr, reason);

    if (default_conn != conn)
    {
        return;
    }

    bt_conn_unref(default_conn);
    default_conn = NULL;

    start_scan();
}

BT_CONN_CB_DEFINE(conn_callbacks) = {
    .connected = connected,
    .disconnected = disconnected,
};

int ble_init()
{
    int err;

    err = bt_enable(NULL);
    if (err)
    {
        printk("Bluetooth init failed (err %d)\n", err);
        return;
    }

    printk("Bluetooth initialized\n");
    printk("Scanning for device with Heart Rate Service\n");

    start_scan();

    return 0;
}
```

## src/ble.h
```c
#ifndef BLE_H
#define BLE_H

int ble_init();

#endif
```

## src/p100_socket.c
```c
#include <zephyr/kernel.h>
#include <dk_buttons_and_leds.h>
#include <zephyr/net/socket.h>
#include <zephyr/drivers/modem/hl7800.h>

#include "p100_socket.h"

LOG_MODULE_REGISTER(p100_socket_log, LOG_LEVEL_INF);

// Thread stack setup
#define P100_SOCKET_STACK_SIZE 1024
#define P100_SOCKET_PRIORITY 5

static void p100_socket_thread();

K_THREAD_STACK_DEFINE(p100_socket_stack_area, P100_SOCKET_STACK_SIZE);
struct k_thread p100_socket_thread_data;

// Hostname and port for the echo server
#define SERVER_IP "20.56.165.163"
#define SERVER_PORT_INT 2444

#define MESSAGE_SIZE 256
#define MESSAGE_TO_SEND "Hello from Pinnacle 100"
#define SSTRLEN(s) (sizeof(s) - 1)

// Structure for the socket and server address
static int sock;
static struct sockaddr_storage server;

// Buffer for receiving from server
static uint8_t recv_buf[MESSAGE_SIZE];

static int server_resolve(void)
{
    // Retrieve the relevant information from the result structure
    struct sockaddr_in *server4 = ((struct sockaddr_in *)&server);

    inet_pton(AF_INET, SERVER_IP, &server4->sin_addr.s_addr);
    server4->sin_family = AF_INET;

    // Flip the port bytes because of how it is being cast
    // This is an error in Zephyr
    server4->sin_port = ((SERVER_PORT_INT >> 8) & 0xff) | ((SERVER_PORT_INT << 8) & 0xff00);

    // Convert the address into a string and print it
    char ipv4_addr[NET_IPV4_ADDR_LEN];
    inet_ntop(AF_INET, &server4->sin_addr.s_addr, ipv4_addr,
              sizeof(ipv4_addr));
    LOG_INF("IPv4 Address found %s", ipv4_addr);

    return 0;
}

static int server_connect(void)
{
    int err;
    // Create a UDP socket
    sock = socket(AF_INET, SOCK_DGRAM, IPPROTO_UDP);
    if (sock < 0)
    {
        LOG_ERR("Failed to create socket: %d.", errno);
        return -errno;
    }

    // Connect the socket to the server
    err = connect(sock, (struct sockaddr *)&server,
                  sizeof(struct sockaddr_in));
    if (err < 0)
    {
        LOG_ERR("Connect failed : %d", errno);
        return -errno;
    }
    LOG_INF("Successfully connected to server");

    return 0;
}

int p100_socket_send(const void *buf, size_t len)
{
    return send(sock, buf, len, 0);
}

static void button_handler(uint32_t button_state, uint32_t has_changed)
{
    switch (has_changed)
    {
    case DK_BTN1_MSK:
        // Call send() when button 1 is pressed
        if (button_state & DK_BTN1_MSK)
        {
            int err = p100_socket_send(MESSAGE_TO_SEND, SSTRLEN(MESSAGE_TO_SEND));
            if (err < 0)
            {
                LOG_INF("Failed to send message, %d", errno);
                return;
            }
            LOG_INF("Successfully sent message: %s", MESSAGE_TO_SEND);
        }
        break;
    }
}

static void p100_socket_thread()
{
    int received;

    LOG_INF("Press button 1 send your message");

    while (1)
    {
        received = recv(sock, recv_buf, sizeof(recv_buf) - 1, 0);

        if (received < 0)
        {
            LOG_ERR("Socket error: %d, exit", errno);
            break;
        }

        if (received == 0)
        {
            LOG_ERR("Empty datagram");
            break;
        }

        recv_buf[received] = 0;
        LOG_INF("Data received from the server: (%s)", recv_buf);
    }

    (void)close(sock);
}

int p100_socket_init()
{

    if (dk_buttons_init(button_handler) != 0)
    {
        LOG_ERR("Failed to initialize the buttons library");
    }

    if (server_resolve() != 0)
    {
        LOG_INF("Failed to resolve server name");
        return -1;
    }

    if (server_connect() != 0)
    {
        LOG_INF("Failed to initialize client");
        return -1;
    }

    // Create the thread
    k_thread_create(
        &p100_socket_thread_data, p100_socket_stack_area,
        K_THREAD_STACK_SIZEOF(p100_socket_stack_area),
        p100_socket_thread,
        NULL, NULL, NULL,
        P100_SOCKET_PRIORITY, 0, K_NO_WAIT);

    return 0;
}
```

## src/p100_socket.h
```c
#ifndef P100_SOCKET_H
#define P100_SOCKET_H

int p100_socket_send(const void *buf, size_t len);
int p100_socket_init();

#endif
```
